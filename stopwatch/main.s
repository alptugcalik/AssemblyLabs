GPIO_PORTF_DATA 	EQU 	0x400253FC			
			AREA		main, READONLY, CODE
            THUMB

			EXPORT		__main
			EXTERN		GPIOINIT_F
			EXTERN		InitSysTick
			EXTERN      DELAY1
			EXTERN		CONVRT
			EXTERN		OutStr
			EXTERN		OutChar	
				
msg1		DCB			"WELCOME TO STOPWATCH\n",0x04
msg2		DCB			">=100",0x04

__main		PROC
			LDR R5,=msg1
			BL OutStr
			bl GPIOINIT_F
			BL InitSysTick
			CPSIE I
			LDR R4,=0x20000604 ; FOR GENERAL COUNT
			MOV R1,#0
			STR R1,[R4]
			LDR R4,=0x20000600 ; FOR 1 SEC BLINK
			STR R1,[R4]
			LDR R4,=0x20000608 ; FOR STOP AND START
			STR R1,[R4]
			;sw1 pf4
			;sw2 Pf0
			; greenled pf3 PB2
INIT		LDR r0,=GPIO_PORTF_DATA
			MOV r1,#0x00
			STR r1,[r0]	
			;PRESS ALGORITHM
DEBOUNCE	
			LDR R1 , =GPIO_PORTF_DATA ; DATA CONFIG OF PORT B
			LDR R4 , [R1]
			BL DELAY1 ;WAIT TIME BTW 2 INPUTS
			LDR R1 , =GPIO_PORTF_DATA ; DATA CONFIG OF PORT B
			LDR R2 , [R1]
			CMP R2,R4 ; DEBOUNCING
			BEQ CONT ; CONT IF 2 VALUES ARE EQUAL
			B DEBOUNCE
CONT
			;MASK THE INPUTS
			AND R3, R2, #0x10
			
			;NO KEY IS PRESSED
			CMP R3,#0x10
			BEQ DEBOUNCE
	
			;RELEASE ALGORITHM
DEBOUNCE2	LDR R1 , =GPIO_PORTF_DATA ; DATA CONFIG OF PORT B
			LDR R7 , [R1]
			AND R5 , R7, #0x10 ; MASK ONLY THE INPUTS
			CMP R5 , #0x10 ;if there is an input go back
			BNE DEBOUNCE2 ;DEBOUNCING
			BL  DELAY1 ;WAIT TIME FOR 2 INPUTS
			LDR R1 , =GPIO_PORTF_DATA ; DATA CONFIG OF PORT B
			LDR R2 , [R1]
			AND R5 , R2, #0x10 ; MASK ONLY THE INPUTS
			CMP R5 , #0x10 ;if there is an input go back
			BNE DEBOUNCE2 ;DEBOUNCING
			
			; AFTER RELASING
			LDR R4,=0x20000608 ; FOR STOP AND START
			ldr r1,[r4]
			CMP R1, #0
			MOVEQ R1,#1
			STREQ R1, [R4]
			BEQ SAL
			CMP R1, #1
			bne SAL
			
			; PRINT THE COUNT
			LDR R4,=0x20000604
			LDR R6,[R4]
			MOV R2,#1000
			UDIV R4,R6,R2 ; MS TO SEC
			cmp r4,#100
			LDRHS R5,=msg2
			BLHS OutStr
			BHS	SAL
			
			LDR R4,=0x20000604
			LDR R6,[R4]
			MOV R2,#1000
			UDIV R4,R6,R2
			LDR R5,=0x20000700
			BL CONVRT
			MOV R5,#46
			BL OutChar
			LDR R4,=0x20000604
			LDR R6,[R4]
			MOV R2,#1000
			UDIV R4,R6,R2
			MUL R4,R4,R2
			sub R4,R6,R4
			MOV R0,#10
			UDIV R4,R4,R0
			LDR R5,=0x20000700
			BL CONVRT
			
			
			; CLEAR
			LDR R4,=0x20000604 ; FOR GENERAL COUNT
			MOV R1,#0
			STR R1,[R4]
			LDR R4,=0x20000600 ; FOR 1 SEC BLINK
			STR R1,[R4]
			LDR R4,=0x20000608 ; FOR STOP AND START
			STR R1,[R4]
			
			
			
SAL			
			
			
			B 	INIT	
			ENDP
			END