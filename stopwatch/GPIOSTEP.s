GPIO_PORTB_DATA 	EQU 	0x400053FC
GPIO_PORTF_DATA 	EQU 	0x400253FC
NVIC_ST_RELOAD 		EQU 	0xE000E014
			AREA		main, READONLY, CODE
            THUMB

			EXPORT		GPIOSTEP
			EXTERN		DELAY

; In this subroutine, the inputs are changed both in ascending and descending order according to a 
; variable in the memory. 
; STEP MOTOR INPUTS ARE CONNECTED TO PB4-PB7
GPIOSTEP	PROC
			LDR R4,=GPIO_PORTB_DATA
			LDR R4,[R4]
			AND R1,R4,#0xF0
			;ROTATION DIRECTION IS CHECKED
			; IF R3 IS 1 -> CW
			; IF R3 IS 2 -> CCW
			LDR R5,=0x20000500
			LDRB R3,[R5]
			CMP R3,#1
			BEQ GO
			LDRB R3,[R5]
			CMP R3,#2
			BEQ GO2
			
			;THE OUTPUT ARE CHANGED SEQUENTIALLY WITH RESPECT TO ROTATION DIRECTION
			;OUTPUTS ARE MADE HIGH IN AN ASCENDING AND DESCENDING ORDER
GO			LDR R6,=GPIO_PORTF_DATA
			MOV R2,#0x8
			STR R2,[R6]
			CMP R1,#0x00
			MOVEQ R1,#0x10
			BEQ OUT
			;CLOCKWISE
			CMP R1,#0x80
			MOVEQ R1,#0x10
			BEQ OUT
			CMP R1,#0x10
			MOVEQ R1,#0x20
			BEQ OUT
			CMP R1,#0x20
			MOVEQ R1,#0x40
			BEQ OUT
			CMP R1,#0x40
			MOVEQ R1,#0x80
			BEQ OUT
			
			;COUNTER CLOCKWISE
GO2			LDR R6,=GPIO_PORTF_DATA
			MOV R2,#0x4
			STR R2,[R6]
			CMP R1,#0x80
			MOVEQ R1,#0x40
			BEQ OUT
			CMP R1,#0x40
			MOVEQ R1,#0x20
			BEQ OUT
			CMP R1,#0x20
			MOVEQ R1,#0x10
			BEQ OUT
			CMP R1,#0x10
			MOVEQ R1,#0x80
			BEQ OUT
			
			;CHANGE THE OUTPUT FOR STEP MOTOR ACCORDINGLY
OUT			BFC R4,#4,#4
			ORR R4,R4,R1
			LDR R0,=GPIO_PORTB_DATA
			STR R4,[R0]
			
			;NOW CONTROL THE SPEED CHANGE
			; IF R3 IS 3 -> SPEED UP
			; IF R3 IS 4 -> SPEED DOWN
			LDR R1 , =NVIC_ST_RELOAD
			LDR R0 , [R1]
			
			LDR R5,=0x20000500
			LDRB R3,[R5,#1]!
			
			CMP R3,#3
			BNE NOT
			CMP R0,#0x2000 ; MAX SPEED LIMIT
			BEQ NOT
			LSR R0,R0,#1
NOT			CMP R3,#4
			BNE NOT2
			CMP R0,#0x100000 ;MIN SPEED LIMIT
			BEQ NOT2
			LSL R0,R0,#1						
NOT2		STR R0 ,[R1]	

			; NOW CLEAR THE MEMORY RESERVED FOR SPEED
			LDR R4,=0x20000501
			MOV R1,#0
			STRB R1,[R4]
			
			BX LR
			ENDP
			END